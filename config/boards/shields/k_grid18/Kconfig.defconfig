## config/boards/shields/k_grid18/Kconfig.defconfig
```kconfig
if SHIELD_K_GRID18_LEFT

config ZMK_SPLIT_ROLE_CENTRAL
    default y

endif

if SHIELD_K_GRID18_RIGHT

config ZMK_SPLIT_ROLE_CENTRAL
    default n

endif

if SHIELD_K_GRID18_LEFT || SHIELD_K_GRID18_RIGHT

config ZMK_KEYBOARD_NAME
    default "kgrid18"

config ZMK_SPLIT
    default y

config BT
    default y

config ZMK_BLE
    default y

endif
```

## config/boards/shields/k_grid18/Kconfig.shield
```kconfig
config SHIELD_K_GRID18_LEFT
    def_bool $(shields_list_contains,k_grid18_left)

config SHIELD_K_GRID18_RIGHT
    def_bool $(shields_list_contains,k_grid18_right)
```
